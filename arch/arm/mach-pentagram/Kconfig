## arch/arm/mach-pentagram/Kconfig
```kconfig
if ARCH_PENTAGRAM

choice
	prompt "Board select"

config TARGET_PENTAGRAM_SP7350
	bool "SP7350 Board (SP7350 C-chip)"
	select ARM64
	select ENABLE_ARM_SOC_BOOT0_HOOK

endchoice

choice
	prompt "Verification Environment"

config SYS_ENV_ZEBU
	bool "zebu environment"

config SYS_ENV_SP7350_EVB
	bool "SP7350 EVB"

endchoice

config SYS_ZMEM_SKIP_RELOC
	bool "zmem skip reloc"
	default y
	depends on SYS_ENV_ZEBU && !SD_BOOT && !NAND_BOOT

config SP_ZMEM_RELOC_ADDR
	hex "zmem reloc address"
	default 0x1F00000
	depends on SYS_ZMEM_SKIP_RELOC
	help
	  Fixed reloc address of u-boot on zmem environemnt.
	  This address is chosen by zmem firmware so follow
	  the zmem layout to assign this value. Zmem will
	  put the image with header on this address so the
	  first word of this address will be first 4 bytes
	  of header not the ENTRY() of text code.

config SP_TIMER
	bool "Sunplus timer"
	default y
	help
	  Support Sunplus STC timer

source "board/sunplus/sp7350/Kconfig"

endif
```

## drivers/pinctrl/sunplus/Kconfig
```kconfig
config PINCTRL_SUNPLUS_SP7350
	bool "Sunplus SP7350 Pinctrl and GPIO driver"
	depends on DM && TARGET_PENTAGRAM_SP7350
	select PINCTRL
	select PINCONF
	select DM_GPIO
	default y
	help
	  Support pin configuration control on Sunplus's SP7350 SoC.

	  The driver is controlled by a device tree node which contains both
	  the GPIO definitions and pin control functions.
	  
config PINCTRL_SUPPORT_GPIO_AO_INT
	bool "Sunplus pin control supports group of GPIO_AO_INT"
	depends on PINCTRL_SUNPLUS_SP7350
	help
	  Say Y if you need to use the group of GPIO_AO_INT.
	  This function is dependent on PINCTRL_SUNPLUS_SP7350. It
	  should be enabled first.
```

## drivers/soc/sunplus/Kconfig
```kconfig
config OTP_SUNPLUS
	bool "Enable OTP driver support for Sunplus SoC"
	help
	  This OTP driver supports Sunplus SP7350 SoC.
	  Say Y if you want to enable OTP function.
```

## drivers/video/sunplus/Kconfig
```kconfig
#
# Sunplus Video configuration
#

source "drivers/video/sunplus/sp7350/disp/Kconfig"
```
