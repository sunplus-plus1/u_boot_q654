## configs/sp7350_emmc_dvb_defconfig
```kconfig
CONFIG_ARM=y
CONFIG_ARCH_PENTAGRAM=y
CONFIG_TEXT_BASE=0x500000
CONFIG_SYS_MALLOC_LEN=0x1000000
CONFIG_SYS_MALLOC_F_LEN=0x40000
CONFIG_ENV_SIZE=0x20000
CONFIG_ENV_OFFSET=0x304400
CONFIG_SYS_ENV_SP7350_EVB=y
# CONFIG_SP_TIMER is not set
CONFIG_SRCADDR_KERNEL=0x2222
CONFIG_SRCADDR_KERNEL_BKUP=0x12222
CONFIG_SRCADDR_DTB=0x2022
CONFIG_ENV_OFFSET_REDUND=0x384400
CONFIG_SYS_LOAD_ADDR=0x2000000
CONFIG_SD_BOOT=y
CONFIG_BOOTDELAY=1
CONFIG_AUTOBOOT_KEYED=y
CONFIG_AUTOBOOT_PROMPT="Autobooting in %d seconds, press \"<Esc>\" to stop\n"
CONFIG_AUTOBOOT_STOP_STR="\x1b"
CONFIG_AUTOBOOT_KEYED_CTRLC=y
CONFIG_USE_PREBOOT=y
CONFIG_BOARD_LATE_INIT=y
CONFIG_CMD_BOOTZ=y
CONFIG_CMD_MD5SUM=y
CONFIG_MD5SUM_VERIFY=y
CONFIG_CMD_MEMINFO=y
CONFIG_CMD_GPIO=y
CONFIG_CMD_GPT=y
CONFIG_CMD_GPT_RENAME=y
CONFIG_CMD_I2C=y
CONFIG_CMD_MMC=y
CONFIG_CMD_PART=y
CONFIG_CMD_SPI=y
CONFIG_DEFAULT_SPI_MODE=0
CONFIG_CMD_USB=y
CONFIG_CMD_DHCP=y
CONFIG_BOOTP_DNS2=y
CONFIG_BOOTP_PREFER_SERVERIP=y
CONFIG_BOOTP_NTPSERVER=y
CONFIG_CMD_TFTPPUT=y
CONFIG_CMD_TFTPSRV=y
CONFIG_CMD_NFS=y
CONFIG_CMD_WGET=y
CONFIG_CMD_MII=y
CONFIG_CMD_PING=y
CONFIG_CMD_PXE=y
CONFIG_CMD_WOL=y
CONFIG_CMD_UUID=y
CONFIG_CMD_EXT2=y
CONFIG_CMD_EXT4=y
CONFIG_CMD_FAT=y
CONFIG_CMD_FS_GENERIC=y
CONFIG_ENV_IS_IN_MMC=y
CONFIG_SYS_REDUNDAND_ENVIRONMENT=y
CONFIG_PROT_UDP=y
CONFIG_BOOTP_SEND_HOSTNAME=y
CONFIG_NET_RANDOM_ETHADDR=y
CONFIG_SERVERIP_FROM_PROXYDHCP=y
CONFIG_SYS_RX_ETH_BUFFER=16
CONFIG_CLK_CCF=y
CONFIG_CLK_COMPOSITE_CCF=y
CONFIG_USB_FUNCTION_FASTBOOT=y
CONFIG_FASTBOOT_BUF_ADDR=0xc00800
CONFIG_FASTBOOT_FLASH=y
CONFIG_FASTBOOT_FLASH_MMC_DEV=0
CONFIG_FASTBOOT_MMC_BOOT_SUPPORT=y
CONFIG_FASTBOOT_MMC_BOOT1_NAME="xboot1"
CONFIG_FASTBOOT_MMC_USER_SUPPORT=y
CONFIG_DM_I2C=y
CONFIG_SYS_I2C_DW=y
CONFIG_SUPPORT_EMMC_BOOT=y
CONFIG_MMC_SP_EMMC=y
CONFIG_MMC_SP_SD=y
CONFIG_PHY_ADDR_ENABLE=y
CONFIG_PHY_ADDR=1
CONFIG_PHY_REALTEK=y
CONFIG_RTL8211F_PHY_FORCE_EEE_RXC_ON=y
CONFIG_DM_MDIO=y
CONFIG_DM_ETH_PHY=y
CONFIG_PHY_GIGE=y
CONFIG_ETH_DESIGNWARE=y
CONFIG_RGMII=y
CONFIG_MII=y
CONFIG_DM_PMIC=y
CONFIG_DM_PMIC_IP6103=y
CONFIG_DM_REGULATOR=y
CONFIG_DM_REGULATOR_IP6103=y
CONFIG_SUNPLUS_SERIAL=y
CONFIG_OTP_SUNPLUS=y
CONFIG_SPI=y
CONFIG_DM_SPI=y
CONFIG_DESIGNWARE_SPI=y
CONFIG_USB=y
CONFIG_DM_USB_GADGET=y
CONFIG_USB_XHCI_HCD=y
CONFIG_USB_XHCI_SPDWC3=y
CONFIG_USB_EHCI_HCD=y
CONFIG_USB_EHCI_SUNPLUS=y
CONFIG_USB_OHCI_HCD=y
CONFIG_USB_OHCI_SUNPLUS=y
CONFIG_USB_STORAGE=y
CONFIG_USB_KEYBOARD=y
CONFIG_USB_GADGET=y
CONFIG_USB_GADGET_MANUFACTURER="Sunplus"
CONFIG_USB_GADGET_VENDOR_NUM=0x04fc
CONFIG_USB_GADGET_PRODUCT_NUM=0xd00d
CONFIG_USB_GADGET_SUNPLUS_UDC=y
CONFIG_VIDEO=y
CONFIG_VIDEO_SP7350=y
CONFIG_VIDEO_BMP_GZIP=y
CONFIG_VIDEO_BMP_RLE8=y
CONFIG_BMP_16BPP=y
CONFIG_BMP_24BPP=y
CONFIG_BMP_32BPP=y
```
